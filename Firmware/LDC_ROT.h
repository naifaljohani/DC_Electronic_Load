

#include <xc.h>

#include "GLCD.h"
#include <stdio.h>
#include <stdlib.h>
#include "string.h"
#include <stdint.h>
#include <stdbool.h>
#define _XTAL_FREQ          16000000

#define DAC1_DoubleBufferLatch() \
    (DACLDbits.DAC1LD = 1)


static const char Alpha1[] = {
                  0x00,0x00,0x00,0x00,0x00,  // 20 space
                  0x00,0x00,0x5f,0x00,0x00,  // 21 !
                  0x00,0x07,0x00,0x07,0x00,  // 22 "
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                  0x3e,0x41,0x51,0x21,0x5e}; // 51 Q

static const char Alpha2[] = {
                  0x7f,0x09,0x19,0x29,0x46,
                  0x46,0x49,0x49,0x49,0x31,  // 53 S
                  0x01,0x01,0x7f,0x01,0x01,  // 54 T
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                  0x78,0x46,0x41,0x46,0x78}; // 7f &brvbar;

const unsigned char black [] = {
0xFF, 0xFF, 0xFF, 0xFF, 0xFF, 0xFF, 0xFF, 0xFF, 0xFF, 0xFF, 0xFF, 0xFF, 0xFF, 0xFF, 0xFF, 0xFF,
0xFF, 0xFF, 0xFF, 0xFF, 0xFF, 0xFF, 0xFF, 0xFF, 0xFF, 0xFF, 0xFF, 0xFF, 0xFF, 0xFF, 0xFF, 0xFF,
0xFF, 0xFF, 0xFF, 0xFF, 0xFF, 0xFF, 0xFF, 0xFF, 0xFF, 0xFF, 0xFF, 0xFF, 0xFF, 0xFF, 0xFF, 0xFF,
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0xFF, 0xFF, 0xFF, 0xFF, 0xFF, 0xFF, 0xFF, 0xFF, 0xFF, 0xFF, 0xFF, 0xFF, 0xFF, 0xFF, 0xFF, 0xFF
};

//------------------------------------------------------------------------------
// File generated by LCD Assistant
// http://en.radzio.dxp.pl/bitmap_converter/
//------------------------------------------------------------------------------

const unsigned char des [] = {
0xFF, 0xF1, 0xFF, 0xFF, 0xFF, 0xFF, 0xFF, 0xFF, 0xFF, 0xFF, 0xFF, 0xFF, 0xFF, 0xFF, 0xFF, 0xFF,
0xFF, 0xE0, 0xFF, 0xFF, 0xFF, 0xFF, 0xFF, 0xFF, 0xFF, 0xFF, 0xFF, 0xFF, 0xFF, 0xFF, 0xFF, 0xFF,
0xFF, 0xF0, 0xFF, 0xFF, 0xFF, 0xFF, 0xFF, 0xFF, 0xFF, 0xFF, 0xFF, 0xFF, 0xFF, 0xFF, 0x8F, 0xFF,
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0xFF, 0xFF, 0xFF, 0xFF, 0xFF, 0xFF, 0xFF, 0xFF, 0xFF, 0xFF, 0xFF, 0xFF, 0xFF, 0xFF, 0xFF, 0xFF
};




void DAC_CONFIG(void)
{
    DAC1CON0 =  0b10100000;
    DACLD    =  0b00000001;
}

void DAC1_Load10bitInputData(uint16_t input16BitData)
{
    //DAC input reference range should be 16bit.
    //Input data left justified.
    DAC1CON0bits.DAC1FM = 1;
    
    //Loading 16bit data to DAC1
    DAC1REFL  = (uint8_t) input16BitData;  
    DAC1REFH  = (uint8_t)(input16BitData >> 8);
    //Loading DAC1 double buffer data to latch.
    DAC1_DoubleBufferLatch();
}
void OSCILLATOR_Initialize(void)
{
   
    // SCS FOSC; SPLLEN disabled; IRCF 500KHz_MF; 
    OSCCON = 0b01111011;
    // SOSCR enabled; 
    OSCSTAT = 0b100000000;
    // TUN 0; 
    OSCTUNE = 0x00;
    // SBOREN disabled; BORFS disabled; 
    BORCON = 0x00;
}

/*
void WDT_Initialize(void)
{
    // WDTPS 1:131072; SWDTEN OFF; 
    WDTCON = 0x18;
}
*/
void LCD_Init(void) 
{ 
	LCD_REST=1; 
	LCD_REST=0; 
	__delay_ms(5);
	LCD_REST=1;  

	__delay_ms(50);

	LCD_WriteCommand(0b00100000); // function set, 4 bit mode
	__delay_ms(5);

	LCD_WriteCommand(0b00100000); // 4 bit mode again
	__delay_ms(5);
	
	LCD_WriteCommand(0b00001100); // display on, cursor off, blink off
	__delay_ms(5);

	LCD_WriteCommand(0x01); 	  // display clear
	__delay_ms(5);

	LCD_WriteCommand(0x06); 	  // Cursor moves right, no display shift.  
	__delay_ms(5);

	LCD_WriteCommand(0b00000010); // Returns to home. Cursor moves to starting point.
	__delay_ms(5);
}
void LCD_WriteByte(unsigned char command)
{
    LCD_EN = 1;
	__delay_us(20);
	// Move higher nibble first
	LCD_DB4 = (command & (1 << 4)) >> 4;
    LCD_DB5 = (command & (1 << 5)) >> 5;
    LCD_DB6 = (command & (1 << 6)) >> 6;
    LCD_DB7 = (command & (1 << 7)) >> 7;
	__delay_us(20);
	LCD_EN = 0;

	LCD_EN = 1;
	__delay_us(20); 
	// Then move the lower nibble
    LCD_DB4 = (command & (1 << 0)) >> 0;
    LCD_DB5 = (command & (1 << 1)) >> 1;
    LCD_DB6 = (command & (1 << 2)) >> 2;
    LCD_DB7 = (command & (1 << 3)) >> 3;
	__delay_us(20);
    LCD_EN = 0;

	__delay_us(20);					// Please increase this __delay if the screen is not showing things correctly.
}

void LCD_WriteData(unsigned char data) //write data
{  
	LCD_RS=1; 
	LCD_WriteByte(data);
} 

void LCD_WriteCommand(unsigned char command) //write command
{ 
	LCD_RS=0; 
	LCD_WriteByte(command);
}

void LCD_TextDisplayString(unsigned char line, char* string)
{  
	unsigned char addr,i; 
	if(line==1) 
		addr=0x80; //The first line address
	else if(line==2) 
		addr=0x90; //The second line address
	else if(line==3) 
		addr=0x88;   //The third line address
	else if(line==4) 
		addr=0x98;    //The fourth line address 

	LCD_WriteCommand(addr); 

	for(i=0;i<16;i++) 
		LCD_WriteData(*string++); 
} 

void LCD_EnableGraphics(void)
{
	LCD_WriteCommand(0x20);		
	__delay_ms(1);
	LCD_WriteCommand(0x24);			// Switch to extended instruction mode.	
	__delay_ms(1);
	LCD_WriteCommand(0x26);			// Enable graphics mode.
	__delay_ms(1);
}

void LCD_DisableGraphics(void)
{
	LCD_WriteCommand(0x20);			// Graphics and extended instruction mode turned off.
	__delay_ms(1);
}

void LCD_FillScreenGraphics(const unsigned char* graphic)
{
	unsigned char x, y;
	for(y = 0; y < 64; y++)
	{
		if(y < 32)
		{
			for(x = 0; x < 8; x++)							// Draws top half of the screen.
			{												// In extended instruction mode, vertical and horizontal coordinates must be specified before sending data in.
				LCD_WriteCommand(0x80 | y);					// Vertical coordinate of the screen is specified first. (0-31)
    			LCD_WriteCommand(0x80 | x);					// Then horizontal coordinate of the screen is specified. (0-8)
				LCD_WriteData(graphic[2*x + 16*y]);			// Data to the upper byte is sent to the coordinate.
				LCD_WriteData(graphic[2*x+1 + 16*y]);		// Data to the lower byte is sent to the coordinate.
			}
		}
		else
		{
			for(x = 0; x < 8; x++)							// Draws bottom half of the screen.
			{												// Actions performed as same as the upper half screen.
				LCD_WriteCommand(0x80 | (y-32));			// Vertical coordinate must be scaled back to 0-31 as it is dealing with another half of the screen.
    			LCD_WriteCommand(0x88 | x);
				LCD_WriteData(graphic[2*x + 16*y]);
				LCD_WriteData(graphic[2*x+1 + 16*y]);
			}
		}
		
	}
}

void LCD_GraphicsDisplayString(unsigned char line, char* str)
{
	// Output text to the LCD in graphics mode using a 5x7 font
	// Each char occupies 6 cols, 8 lines, including of space to next char
	unsigned char row;
	unsigned char colInd;
	unsigned char shouldContinue = 1;
	unsigned char count = 0;

	while(*str && shouldContinue)
	{
		unsigned char letterA = *str++;
		if (letterA == 0)
		{
			letterA = 32;
			shouldContinue = 0;
		}

		// if string length is odd, last letter does not come in pair, append space			
		unsigned char letterB = *str++;
		if (letterB == 0) 
		{
			letterB = 32; // odd number of characters in a string, replace NULL with space		
			shouldContinue = 0;
		}

		unsigned char indA = letterA < 0x52 ? letterA - 0x20 : letterA - 0x52;
		unsigned char indB = letterB < 0x52 ? letterB - 0x20 : letterB - 0x52;
		unsigned char colListA[5];
		unsigned char colListB[5];
	
	    if(letterA < 0x52){
			colListA[4] = Alpha1[(indA*5)];
			colListA[3] = Alpha1[(indA*5)+1];
			colListA[2] = Alpha1[(indA*5)+2];
			colListA[1] = Alpha1[(indA*5)+3];
			colListA[0] = Alpha1[(indA*5)+4];
		}
		else
		{
			colListA[4] = Alpha2[(indA*5)];
			colListA[3] = Alpha2[(indA*5)+1];
			colListA[2] = Alpha2[(indA*5)+2];
			colListA[1] = Alpha2[(indA*5)+3];
			colListA[0] = Alpha2[(indA*5)+4];
		}
	
	    if(letterB < 0x52){
			colListB[4] = Alpha1[(indB*5)];
			colListB[3] = Alpha1[(indB*5)+1];
			colListB[2] = Alpha1[(indB*5)+2];
			colListB[1] = Alpha1[(indB*5)+3];
			colListB[0] = Alpha1[(indB*5)+4];
		}
		else
		{
			colListB[4] = Alpha2[(indB*5)];
			colListB[3] = Alpha2[(indB*5)+1];
			colListB[2] = Alpha2[(indB*5)+2];
			colListB[1] = Alpha2[(indB*5)+3];
			colListB[0] = Alpha2[(indB*5)+4];
		}

		for (row=0;row<8;row++)
		{
			if (line < 4)	// first half
			{
				LCD_WriteCommand(0x80 | (line * 8 + row));
				LCD_WriteCommand(0x80 | count);
			}
			else
			{
				LCD_WriteCommand(0x80 | ( (line-4) * 8 + row));
				LCD_WriteCommand(0x88 | count);
			}
					
			unsigned char dataA = 0x00;
			for (colInd=0;colInd<5;colInd++)
			{
				if (colListA[colInd] & (1 << row))
				{
					dataA = dataA | (1 << (colInd+3));
				}
			}

			unsigned char dataB = 0x00;
			for (colInd=0;colInd<5;colInd++)
			{
				if (colListB[colInd] & (1 << row))
				{
					dataB = dataB | (1 << (colInd+3));
				}
			}
	
			LCD_WriteData(dataA);
			LCD_WriteData(dataB);
		}

		count++;
	}
}

void LCD_ClearGraphics(void)
{
	// This function performs similar to the LCD_FillScreenGraphics but
	// only zeros are sent into the screen instead of data from an array.
	unsigned char x, y;
	for(y = 0; y < 64; y++)
	{
		if(y < 32)
		{
			LCD_WriteCommand(0x80 | y);
    		LCD_WriteCommand(0x80);
		}
		else
		{
			LCD_WriteCommand(0x80 | (y-32));
    		LCD_WriteCommand(0x88);
		}
		for(x = 0; x < 8; x++)
		{
			LCD_WriteData(0x00);
			LCD_WriteData(0x00);
		}
	}
}